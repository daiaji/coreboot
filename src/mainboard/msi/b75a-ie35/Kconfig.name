## src/mainboard/msi/b85m-e45/Kconfig
```kconfig
# SPDX-License-Identifier: GPL-2.0-or-later

if BOARD_MSI_B85M_E45

config BOARD_SPECIFIC_OPTIONS
	def_bool y
	select BOARD_ROMSIZE_KB_16384
	select CPU_INTEL_HASWELL
	select HAVE_ACPI_RESUME
	select HAVE_ACPI_TABLES
	select INTEL_GMA_HAVE_VBT
	select MAINBOARD_HAS_LIBGFXINIT
	select NORTHBRIDGE_INTEL_HASWELL
	select SERIRQ_CONTINUOUS_MODE
	select SOUTHBRIDGE_INTEL_LYNXPOINT
	select SUPERIO_NUVOTON_NCT6779D

config CBFS_SIZE
	default 0x200000

config MAINBOARD_DIR
	default "msi/b85m-e45"

config MAINBOARD_PART_NUMBER
	default "B85M-E45"

endif
```
